## build/conf/bblayers.conf
```bitbake
# LAYER_CONF_VERSION is increased each time build/conf/bblayers.conf
# changes incompatibly
LCONF_VERSION = "6"

BBPATH = "${TOPDIR}"
OEROOT := "${@os.path.abspath(os.path.dirname(d.getVar('FILE', True)) + '/../../sources/poky')}"
BBFILES ?= ""

BBLAYERS ?= " \
  ${OEROOT}/meta \
  ${OEROOT}/meta-yocto \
  ${OEROOT}/meta-yocto-bsp \
  ${OEROOT}/../meta-ccu-eevo-bsp \
  ${OEROOT}/../meta-eevo \
  "
BBLAYERS_NON_REMOVABLE ?= " \
  ${OEROOT}/sources/poky/meta \
  ${OEROOT}/sources/poky/meta-yocto \
  "
```

## sources/meta-ccu-eevo-bsp/conf/layer.conf
```bitbake
# We have a conf and classes directory, add to BBPATH
BBPATH .= ":${LAYERDIR}"

# We have a recipes-* directories, add to BBFILES
BBFILES += "${LAYERDIR}/recipes-*/*/*.bb \
	${LAYERDIR}/recipes-*/*/*.bbappend"

BBFILES += "${LAYERDIR}/recipes*/*/*.bb ${LAYERDIR}/recipes*/*/*.bbappend"

BBFILE_COLLECTIONS += "ccu-eevo"
BBFILE_PATTERN_ccu-eevo = "^${LAYERDIR}/"
BBFILE_PRIORITY_ccu-eevo = "6"
```

## sources/meta-eevo/conf/layer.conf
```bitbake
# We have a conf and classes directory, append to BBPATH
BBPATH .= ":${LAYERDIR}"

# We have a recipes directory, add to BBFILES
BBFILES += "${LAYERDIR}/recipes*/*/*.bb ${LAYERDIR}/recipes*/*/*.bbappend"

BBFILE_COLLECTIONS += "eevo"
BBFILE_PATTERN_eevo := "^${LAYERDIR}/"
BBFILE_PRIORITY_eevo = "10"

LICENSE_PATH += "${LAYERDIR}/licenses"

# Layer dependencies
# LAYERDEPENDS_eevo = "phytec openembedded-layer networking-layer meta-python multimedia-layer qt5-layer"
# dummy comment
```
